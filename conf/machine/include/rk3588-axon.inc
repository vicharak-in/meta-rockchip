## conf/machine/include/rk3588-axon.inc
```bitbake
SOC_FAMILY = "rk3588"

require conf/machine/include/arm/arch-armv8a.inc
require conf/machine/include/soc-family.inc
MACHINEOVERRIDES =. "mali-gpu:mali-midgard:"

PREFERRED_PROVIDER_virtual/kernel = "linux-rockchip"
PREFERRED_VERSION_linux-rockchip = "5.10%"

SERIAL_CONSOLES = "1500000;ttyFIQ0"
KERNEL_IMAGETYPE = "Image"
KBUILD_DEFCONFIG = "rockchip_linux_defconfig"
KBUILD_DEFCONFIGS = "rk3588_axon.config"

PREFERRED_PROVIDER_virtual/bootloader ?= "u-boot-rockchip"

MACHINE_ESSENTIAL_EXTRA_RRECOMMENDS += "\
   rkwifibt-firmware-rtl8852bs-bt \
   kernel-modules \
"
```

## conf/machine/rk3588-axon.conf
```bitbake
# Copyright (c) 2026 Vicharak Computers Pvt. Ltd.
# Released under the MIT license (see COPYING.MIT for the terms)

#@TYPE: Machine
#@NAME: rk3588 Vicharak axon

require conf/machine/include/vicharak-common.inc
require conf/machine/include/rk3588.inc

KERNEL_DEVICETREE = "rockchip/rk3588-axon-linux.dtb"
PREFERRED_VERSION_linux-rockchip = "6.1%"
LINUXLIBCVERSION = "6.1-vicharak%"
UBOOT_MACHINE = "rk3588-axon_defconfig"

RK_WIFIBT_FIRMWARES = " \
    rtl-tools \
"
SOC_BOARD = "axon"
SOC_FAMILY = "rk3588"
SOC = "rockchip"
YOCTO_VERSION="scarthgap"

DISPLAY_PLATFORM = "x11"
PACKAGE_CLASSES = "package_deb"
EXTRA_IMAGE_FEATURES += "package-management"
```

## wic/rk3399-vaaman.wks
```
# Rockchip RK3399 Vaaman - vfat boot partition

bootloader --ptable gpt
part --source rawcopy --sourceparams="file=idblock.img" --align 32 --no-table
part --source rawcopy --sourceparams="file=uboot.img" --part-name uboot --align 8192 --no-table
part --source rawcopy --sourceparams="file=trust.img" --part-name trust --no-table
part /boot --no-fstab-update --use-uuid --source bootimg-partition --fstype vfat --label boot --size 128M
part / --source rootfs --fstype ext4 --part-name rootfs --uuid 614e0000-0000-4b53-8000-1d28000054a9 --align 8192
```
